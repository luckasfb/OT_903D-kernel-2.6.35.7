
; =========================================
; Please DO NOT modify this section - START
; =========================================
SYStem.RESet
SYStem.CPU ARM926EJ
;SYStem.JtagClock 1000000.
SYStem.JtagClock RTCK.
sys.o cflush on
jtag.LOCK 
jtag.pin.enable
jtag.pin.NRESET LOW
jtag.pin.NTRST LOW 
jtag.pin.TCK LOW
wait 50.ms
jtag.pin.NRESET HIGH
wait 600.ms
jtag.pin.NTRST HIGH
jtag.UNLOCK 
sys.m.ATTACH 
break

setup.IMASKHLL ON
setup.IMASKASM ON

D.S SD:0x50004000 %LE %LONG 0x4D544B53 ;MTK ID

SYStem.RESet
SYStem.CPU ARM926EJ
;SYStem.JtagClock 1000000.
SYStem.JtagClock RTCK.
sys.o cflush on
jtag.LOCK 
jtag.pin.enable
jtag.pin.NRESET LOW
jtag.pin.NTRST LOW 
jtag.pin.TCK LOW
wait 50.ms
jtag.pin.NRESET HIGH
wait 600.ms
jtag.pin.NTRST HIGH
jtag.UNLOCK 
sys.m.ATTACH 
break

setup.IMASKHLL ON
setup.IMASKASM ON
; =========================================
; Please DO NOT modify this section - END
; =========================================






