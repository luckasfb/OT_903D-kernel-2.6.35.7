
SYStem.RESet
SYStem.CPU ARM1176JZ
SYStem.JtagClock Rtck
System.Option Cflush on         ;flush the cache to avoid data consistency
System.Option ResBreak off      ;Don't hold the ARM11 core after reset
;System.Option EnReset off
System.Option EnReset on
SYStem.Up
setup.IMASKHLL ON
setup.IMASKASM ON

wait 100.ms

; set_hw_breakpoint_by_def
; setting attribute of breakpoints
Break.Select Program OnChip
Break.Select Hll OnChip
Break.Select Spot OnChip
Break.Select Read OnChip
Break.Select Write OnChip

D.S C15:0x1 0				; Turn off MMU

;
; board init
;
;do MT6573_FPGA_DDR.cmm
;do MT6573_EVB_DDR.cmm

print "loading pre-loader image"
d.load.elf ../../bin/preloader_mt6573_evb.elf

Y.SPATH.RESET ; reset all source path
Y.SPATH.SRD ../../../../platform/mt6573/preloader/src/init
Y.SPATH.SRD ../../../../platform/mt6573/preloader/src/lib
Y.SPATH.SRD ../../../../platform/mt6573/preloader/src/modules
Y.SPATH.SRD ../../../../custom/mt6573_evb/preloader

R.S PC 0x90007000
D.L

enddo



